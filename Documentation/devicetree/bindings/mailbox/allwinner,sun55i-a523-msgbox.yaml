## Documentation/devicetree/bindings/mailbox/allwinner,sun55i-a523-msgbox.yaml
```yaml
# SPDX-License-Identifier: GPL-2.0
%YAML 1.2
---
$id: http://devicetree.org/schemas/mailbox/allwinner,sun55i-a523-msgbox.yaml#
$schema: http://devicetree.org/meta-schemas/core.yaml#

title: Allwinner sun55i (T527/A523) Message Box

maintainers:
  - Juan Sanchez Fuentes <juanesf91@gmail.com>

description: |
  The hardware message box on sun55i SoCs (T527/A523) is a four-user mailbox
  controller containing 12 unidirectional FIFOs shared between the ARM, CPUS,
  DSP and RV (E906) processors. Each user has its own register block. An
  interrupt is raised for received messages, but software must poll to know
  when a transmitted message has been acknowledged by the remote user. Each
  FIFO can hold fifteen 32-bit messages; when a FIFO is full, clients must
  wait before attempting more transmissions.

  Refer to ./mailbox.txt for generic information about mailbox device-tree
  bindings.

properties:
  compatible:
    oneOf:
      - items:
          - enum:
              - allwinner,sun55i-a523-msgbox
          - const: allwinner,sun55iw3-msgbox
      - const: allwinner,sun55i-a523-msgbox
      - const: allwinner,sun55iw3-msgbox

  reg:
    maxItems: 4
    description: one register block per mailbox user

  reg-names:
    items:
      - const: arm
      - const: cpus
      - const: dsp
      - const: rv

  clocks:
    maxItems: 1
    description: bus clock

  resets:
    maxItems: 1
    description: bus reset

  interrupts:
    maxItems: 1
    description: interrupt for the local (ARM) block

  '#mbox-cells':
    const: 1
    description: first cell is the channel number (0-11)

required:
  - compatible
  - reg
  - reg-names
  - clocks
  - resets
  - '#mbox-cells'

additionalProperties: false

examples:
  - |
    #include <dt-bindings/clock/sun55i-a523-ccu.h>
    #include <dt-bindings/interrupt-controller/arm-gic.h>
    #include <dt-bindings/reset/sun55i-a523-ccu.h>

    msgbox: mailbox@3003000 {
        compatible = "allwinner,sun55i-a523-msgbox",
                     "allwinner,sun55iw3-msgbox";
        reg = <0x03003000 0x1000>,
              <0x07120000 0x1000>,
              <0x07094000 0x1000>,
              <0x07136000 0x1000>;
        reg-names = "arm", "cpus", "dsp", "rv";
        clocks = <&ccu CLK_BUS_MSGBOX>;
        resets = <&ccu RST_BUS_MSGBOX>;
        interrupts = <GIC_SPI 0 IRQ_TYPE_LEVEL_HIGH>;
        #mbox-cells = <1>;
    };

...
```

## Documentation/devicetree/bindings/remoteproc/allwinner,sun55i-a523-rproc.yaml
```yaml
# SPDX-License-Identifier: (GPL-2.0 OR BSD-2-Clause)
%YAML 1.2
---
$id: http://devicetree.org/schemas/remoteproc/allwinner,sun55i-a523-rproc.yaml#
$schema: http://devicetree.org/meta-schemas/core.yaml#

title: Allwinner sun55i (T527/A523) E906 remoteproc

description: |
  This document defines the binding for the remoteproc component that loads
  and boots a firmware on the E906 RISC-V core of the Allwinner sun55i SoCs
  (T527/A523). The E906 communicates with the application CPUs through the
  sun55i message box, and shares DDR through the memory-region carveouts.

maintainers:
  - Juan Sanchez Fuentes <juanesf91@gmail.com>

properties:
  compatible:
    oneOf:
      - items:
          - const: allwinner,sun55i-a523-rproc
          - const: allwinner,e906-rproc
      - const: allwinner,e906-rproc

  reg:
    maxItems: 3
    description: |
      Configuration block, plus the two RISC-V SRAMs (R_SRAM and R_SRAM1)
      that the E906 core boots from.

  reg-names:
    items:
      - const: cfg
      - const: r_sram
      - const: r_sram1

  clocks:
    maxItems: 3

  clock-names:
    items:
      - const: bus
      - const: core
      - const: sram

  resets:
    maxItems: 4

  reset-names:
    items:
      - const: cfg
      - const: core
      - const: sram
      - const: debug

  mboxes:
    maxItems: 1
    description: channel used to kick a virtqueue on the E906

  mbox-names:
    const: kick

  memory-region:
    minItems: 4
    description: |
      Carveouts for the virtio vrings/vbuffer and the DDR window shared with
      the E906. They keep the same device and physical addresses.

required:
  - compatible
  - reg
  - reg-names
  - clocks
  - clock-names
  - resets
  - reset-names

additionalProperties: false

examples:
  - |
    #include <dt-bindings/clock/sun55i-a523-mcu-ccu.h>
    #include <dt-bindings/interrupt-controller/arm-gic.h>
    #include <dt-bindings/reset/sun55i-a523-mcu-ccu.h>

    rproc: rproc@7130000 {
        compatible = "allwinner,sun55i-a523-rproc",
                     "allwinner,e906-rproc";
        reg = <0x07130000 0x1000>,
              <0x07280000 0x40000>,
              <0x072c0000 0x40000>;
        reg-names = "cfg", "r_sram", "r_sram1";
        clocks = <&mcu_ccu CLK_BUS_MCU_RISCV_CFG>,
                 <&mcu_ccu CLK_MCU_RISCV>,
                 <&mcu_ccu CLK_BUS_MCU_PUBSRAM>;
        clock-names = "bus", "core", "sram";
        resets = <&mcu_ccu RST_BUS_MCU_RISCV_CFG>,
                 <&mcu_ccu RST_BUS_MCU_RISCV_CORE>,
                 <&mcu_ccu RST_BUS_MCU_PUBSRAM>,
                 <&mcu_ccu RST_BUS_MCU_RISCV_DEBUG>;
        reset-names = "cfg", "core", "sram", "debug";
        mboxes = <&msgbox 8>;
        mbox-names = "kick";
        memory-region = <&rv_vdev0buffer>, <&rv_vdev0vring0>,
                        <&rv_vdev0vring1>, <&e906_dram_reserved>;
        status = "okay";
    };

...
```

## arch/arm/configs/xiaomi_cancro_defconfig
```kconfig
# Core Platform Architecture
CONFIG_ARCH_QCOM=y
CONFIG_ARCH_MSM8974=y
CONFIG_SMP=y
CONFIG_ARM_LPAE=n
CONFIG_CPU_V7=y
CONFIG_AEABI=y
CONFIG_HIGHMEM=y

# Power Management & System Core
CONFIG_PM=y
CONFIG_PM_SLEEP=y
CONFIG_WQ_POWER_EFFICIENT=y
CONFIG_ARM_PSCI=y
CONFIG_QCOM_RPM=y
CONFIG_QCOM_SMD_RPM=y
CONFIG_QCOM_COMMAND_DB=y
CONFIG_QCOM_LOCAL_POWER_RAIL=y

# Bus and Interfaces
CONFIG_ARM_AMBA=y
CONFIG_SPMI=y
CONFIG_SPMI_MSM_PMIC_ARB=y
CONFIG_GENERIC_PINCTRL=y
CONFIG_PINCTRL_MSM=y
CONFIG_PINCTRL_MSM8974=y

# Regulators (PM8941)
CONFIG_REGULATOR=y
CONFIG_REGULATOR_FIXED_VOLTAGE=y
CONFIG_REGULATOR_QCOM_SPMI=y
CONFIG_REGULATOR_QCOM_RPM=y

# Storage Controllers (eMMC)
CONFIG_MMC=y
CONFIG_MMC_BLOCK=y
CONFIG_MMC_SDHCI=y
CONFIG_MMC_SDHCI_PLTFM=y
CONFIG_MMC_SDHCI_MSM=y

# Display Subsystem (Sharp FHD Video Panel)
CONFIG_HAS_IOMMU=y
CONFIG_IOMMU_SUPPORT=y
CONFIG_QCOM_IOMMU=y
CONFIG_DRM=y
CONFIG_DRM_MIPI_DSI=y
CONFIG_DRM_MSM=y
CONFIG_DRM_PANEL_SIMPLE=y

# Backlight & LEDs
CONFIG_BACKLIGHT_CLASS_DEVICE=y
CONFIG_LEDS_CLASS=y
CONFIG_LEDS_QCOM_WLED=y
CONFIG_PWM=y
CONFIG_PWM_QCOM_LPG=y

# Input Mechanisms (Synaptics Touch & Buttons)
CONFIG_INPUT=y
CONFIG_INPUT_EVDEV=y
CONFIG_INPUT_KEYBOARD=y
CONFIG_INPUT_GPIO_KEYS=y
CONFIG_INPUT_PM8941_PWRKEY=y
CONFIG_INPUT_TOUCHSCREEN=y
CONFIG_INPUT_TOUCHSCREEN_SYNAPTICS_RMI4=y
CONFIG_RMI4_I2C=y
CONFIG_RMI4_F11=y
CONFIG_RMI4_F12=y

# Serial & Debugging
CONFIG_SERIAL_8250=y
CONFIG_SERIAL_MSM=y
CONFIG_SERIAL_MSM_CONSOLE=y

# Wireless & Remote Processors (WCN3680 WiFi/BT)
CONFIG_NET=y
CONFIG_WIRELESS=y
CONFIG_CFG80211=y
CONFIG_MAC80211=y
CONFIG_WCN36XX=y
CONFIG_REMOTEPROC=y
CONFIG_QCOM_Q6V5_PAS=y
CONFIG_QCOM_SYSMON=y
CONFIG_QCOM_WCNSS_CTRL=y
CONFIG_RPMSG_CHAR=y
CONFIG_RPMSG_QCOM_SMD=y

# Bluetooth
CONFIG_BT=y
CONFIG_BT_RFCOMM=y
CONFIG_BT_HCIUART=y
CONFIG_BT_HCIUART_QCA=y

# USB Core
CONFIG_USB=y
CONFIG_USB_SUPPORT=y
CONFIG_USB_EHCI_HCD=y
CONFIG_USB_CHIPIDEA=y
CONFIG_USB_CHIPIDEA_UDC=y
CONFIG_USB_CHIPIDEA_HOST=y
CONFIG_USB_MSM_OTG=y
CONFIG_NOP_USB_XCEIV=y
CONFIG_USB_GADGET=y

# File Systems & Base Requirements
CONFIG_DEVTMPFS=y
CONFIG_DEVTMPFS_MOUNT=y
CONFIG_EXT4_FS=y
CONFIG_TMPFS=y
```

## bsp/drivers/net/phy/Kconfig
```kconfig
# SPDX-License-Identifier: GPL-2.0-only
#
# PHY Layer Configuration
#

menu "PHY"
        depends on PHYLIB

source "$(BSP_TOP)drivers/net/phy/jlsemi/Kconfig"

endmenu
```

## bsp/drivers/pci/Kconfig
```kconfig
# SPDX-License-Identifier: GPL-2.0
#
# PCI configuration
#

menu "PCI Drivers"

if PCI
source "$(BSP_TOP)drivers/pci/controller/Kconfig"
endif

endmenu
```

## bsp/drivers/pci/controller/Kconfig
```kconfig
# SPDX-License-Identifier: GPL-2.0

menu "PCI controller drivers"
	depends on PCI

source "$(BSP_TOP)drivers/pci/controller/allwinner/Kconfig"
source "$(BSP_TOP)drivers/pci/controller/dwc/Kconfig"

endmenu
```

## bsp/drivers/sound/Kconfig
```kconfig
# SPDX-License-Identifier: GPL-2.0-or-later
#
# Allwinner audio driver Kconfig
#
# Copyright(c) 2022-2027 Allwinnertech Co., Ltd.

menu "SOUND Drivers"
	depends on AW_BSP

if SND_SOC
	if ARCH_SUN60IW3
		source "$(BSP_TOP)drivers/sound/ahub/Kconfig"
	endif
	if !ARCH_SUN60IW3
		source "$(BSP_TOP)drivers/sound/platform/Kconfig"
	endif
	source "$(BSP_TOP)drivers/sound/codecs/Kconfig"
	source "$(BSP_TOP)drivers/sound/misc/Kconfig"
	source "$(BSP_TOP)drivers/sound/pa/Kconfig"
endif

endmenu
```
